## west.yml
```yaml
# Copyright (c) 2021 Nordic Semiconductor ASA
# SPDX-License-Identifier: Apache-2.0

manifest:
  self:
    west-commands: scripts/west-commands.yml

  remotes:
    - name: dozack
      url-base: https://github.com/dozack

  projects:
    - name: zephyr
      remote: dozack
      revision: feature/add-ti-hercules-tms570
      import:
        name-allowlist:
          - cmsis       # required by the ARM port
          - hal_ti
```
